#include <dt-bindings/zmk/matrix_transform.h>

/ {
    chosen {
        zmk,kscan = &kscan0;
        zmk,matrix-transform = &default_transform;
    };

    kscan0: kscan {
        compatible = "zmk,kscan-gpio-direct";
        input-gpios =
            <&gpio0 20 (GPIO_ACTIVE_LOW | GPIO_PULL_UP)>
            ,<&gpio0 22 (GPIO_ACTIVE_LOW | GPIO_PULL_UP)>
            ,<&gpio0 24 (GPIO_ACTIVE_LOW | GPIO_PULL_UP)>
            ,<&gpio1 00 (GPIO_ACTIVE_LOW | GPIO_PULL_UP)>;
    };

    default_transform: matrix_transform {
        compatible = "zmk,matrix-transform";
        rows = <1>;
        columns = <4>;

        map = <
            RC(0,0) RC(0,1) RC(0,2) RC(0,3)
        >;
    };
};